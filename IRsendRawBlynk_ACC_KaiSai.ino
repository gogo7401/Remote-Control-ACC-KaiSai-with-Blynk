// #define ... 
#define BLYNK_PRINT Serial
#define IR_LED 4  // ESP8266 GPIO pin to use. Recommended: 4 (D2).


// #include ...
#ifndef UNIT_TEST
#include <Arduino.h>
#endif
#include <IRremoteESP8266.h>
#include <IRsend.h>
#include <ESP8266WiFi.h>
#include <BlynkSimpleEsp8266.h>

// Your WiFi credentials.
// Set password to "" for open networks.
const char* ssid = "your WiFi SSID";
const char* password ="your password";

// You should get Auth Token in the Blynk App.
// Go to the Project Settings (nut icon).
char auth[] = "your authentication token"; // My Local Server BLYNK - ACC KaiSai Office

IPAddress ip(192, 168, 2, xx); // where xx is the desired IP Address
IPAddress gateway(192, 168, 2, xx); // set gateway to match your network
IPAddress dns(8, 8, 8, 8);
IPAddress subnet(255, 255, 255, 0); // set subnet mask to match your network


IPAddress server_ip (xxx, xxx, xxx, xxx); // IP address on your public Server 

IRsend irsend(IR_LED);  // Set the GPIO to be used to sending the message.

// Example of data captured by IRrecvDumpV2.ino
uint16_t rawDataOn[199] = {4398, 4420,  538, 1614,  516, 536,  562, 1614,  538, 1614,  514, 562,  536,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 1636,  536};  // COOLIX B2BFC0
uint16_t rawDataOff[199] = {4394, 4424,  536, 1614,  514, 560,  516, 1638,  512, 1612,  540, 560,  512,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 1640,  512};  // COOLIX B27BE0 
uint16_t rawData21[199] = {4424, 4394,  566, 1586,  564, 512,  566, 1608,  540, 1612,  540, 534,  544,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 1588,  564};  // COOLIX B2BF60
uint16_t rawData22[199] = {4424, 4394,  564, 1588,  564, 534,  540, 1588,  562, 1588,  566, 510,  564,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 1612,  538};  // COOLIX B2BF70
uint16_t rawData23[199] = {4426, 4394,  564, 1592,  562, 512,  562, 1590,  562, 1588,  564, 512,  564,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 1588,  564};  // COOLIX B2BF50
uint16_t rawData24[199] = {4420, 4398,  540, 1614,  536, 538,  560, 1590,  540, 1610,  560, 514,  564,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 1612,  540};  // COOLIX B2BF40
uint16_t rawData25[199] = {4424, 4420,  542, 1588,  542, 536,  564, 1588,  538, 1612,  538, 536,  564,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 1612,  564};  // COOLIX B2BFC0
uint16_t rawData26[199] = {4400, 4394,  562, 1592,  562, 528,  550, 1588,  562, 1590,  558, 516,  562,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 1590,  562};  // COOLIX B2BFD0
uint16_t rawData27[199] = {4424, 4396,  562, 1590,  560, 516,  562, 1588,  562, 1590,  562, 514,  560,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 1612,  562};  // COOLIX B2BF90
uint16_t rawData28[199] = {4424, 4396,  562, 1590,  562, 514,  562, 1588,  538, 1614,  538, 536,  562,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 1592,  564};  // COOLIX B2BF80
uint16_t rawData29[199] = {4424, 4396,  564, 1588,  562, 514,  564, 1588,  540, 1612,  560, 516,  564,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 1592,  564};  // COOLIX B2BFA0
uint16_t rawData30[199] = {4422, 4398,  562, 1590,  564, 514,  562, 1590,  560, 1590,  560, 516,  564,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 1588,  562};  // COOLIX B2BFB0
uint16_t rawDataFan1[199] = {4398, 4422,  538, 1614,  536, 564,  538, 1616,  536, 1588,  564, 536,  536,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 1618,  534};  // COOLIX B29FC0
uint16_t rawDataFan2[199] = {4394, 4424,  514, 1636,  516, 560,  536, 1614,  514, 1638,  514, 562,  512,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 1640,  534};  // COOLIX B25FC0
uint16_t rawDataFan3[199] = {4392, 4426,  510, 1642,  532, 546,  508, 1640,  510, 1640,  512, 566,  508,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 1628,  512};  // COOLIX B23FC0
uint16_t rawDataFanAuto[199] = {4348, 4472,  486, 1668,  484, 588,  488, 1664,  488, 1664,  488, 590,  484,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 1662,  486};  // COOLIX B2BFC0

// BEGIN - implementation procedures

// setupWiFi

void setupWiFi()
{
    WiFi.config(ip,dns,gateway,subnet);
    WiFi.begin(ssid, password);
  // Wait for connection
  while (WiFi.status() != WL_CONNECTED) {
    delay(500);
    Serial.print(".");
  }
  Serial.println("");
  Serial.print("Connected to ");
  Serial.println(ssid);
  Serial.print("IP address: ");
  Serial.println(WiFi.localIP());
}


BLYNK_WRITE(V1)
{
  int pinValue = param.asInt(); // assigning incoming value from pin V3 to a variable
  Serial.print("V1 value is: "); // to seral monitor
  Serial.println(pinValue);
  if (pinValue == 1) {
        //HIGH - ON
       Serial.println(F("Pin is HIGH")); // to seral monitor
       irsend.sendRaw(rawDataOn, 199, 38);  // Send a raw data capture at 38kHz. 
    }else {
       //LOW - OFF
      Serial.println(F("Pin is LOW"));  // to seral monitor
      irsend.sendRaw(rawDataOff, 199, 38);  // Send a raw data capture at 38kHz.    
    }
}

BLYNK_WRITE(V2)
{
  int pinValue = param.asInt(); // assigning incoming value from pin V3 to a variable
  Serial.print("V2 temp value is: "); // to seral monitor
  Serial.println(pinValue);
  if (pinValue == 21) {
        //HIGH - ON
       Serial.println(F("21")); // to seral monitor
       irsend.sendRaw(rawData21, 199, 38);  // Send a raw data capture at 38kHz. 
  }
  if (pinValue == 22) {
        //HIGH - ON
       Serial.println(F("22")); // to seral monitor
       irsend.sendRaw(rawData22, 199, 38);  // Send a raw data capture at 38kHz. 
  }
  if (pinValue == 23) {
        //HIGH - ON
       Serial.println(F("23")); // to seral monitor
       irsend.sendRaw(rawData23, 199, 38);  // Send a raw data capture at 38kHz. 
  }
  if (pinValue == 24) {
        //HIGH - ON
       Serial.println(F("24")); // to seral monitor
       irsend.sendRaw(rawData24, 199, 38);  // Send a raw data capture at 38kHz. 
  }
  if (pinValue == 25) {
        //HIGH - ON
       Serial.println(F("25")); // to seral monitor
       irsend.sendRaw(rawData25, 199, 38);  // Send a raw data capture at 38kHz. 
  }
  if (pinValue == 26) {
        //HIGH - ON
       Serial.println(F("26")); // to seral monitor
       irsend.sendRaw(rawData26, 199, 38);  // Send a raw data capture at 38kHz. 
  }
  if (pinValue == 27) {
        //HIGH - ON
       Serial.println(F("27")); // to seral monitor
       irsend.sendRaw(rawData27, 199, 38);  // Send a raw data capture at 38kHz. 
  }
  if (pinValue == 28) {
        //HIGH - ON
       Serial.println(F("28")); // to seral monitor
       irsend.sendRaw(rawData28, 199, 38);  // Send a raw data capture at 38kHz. 
  }
  if (pinValue == 29) {
        //HIGH - ON
       Serial.println(F("29")); // to seral monitor
       irsend.sendRaw(rawData29, 199, 38);  // Send a raw data capture at 38kHz. 
  }
  if (pinValue == 30) {
        //HIGH - ON
       Serial.println(F("30")); // to seral monitor
       irsend.sendRaw(rawData30, 199, 38);  // Send a raw data capture at 38kHz. 
  }    
}

BLYNK_WRITE(V3)
{
  int pinValue = param.asInt(); // assigning incoming value from pin V3 to a variable
  Serial.print("V3 FAN value is: "); // to seral monitor
  Serial.println(pinValue);
  if (pinValue == 100) {
        //HIGH - ON
       Serial.println(F("Auto")); // to seral monitor
       irsend.sendRaw(rawDataFanAuto, 199, 38);  // Send a raw data capture at 38kHz. 
  }
  if (pinValue == 101) {
        //HIGH - ON
       Serial.println(F("1")); // to seral monitor
       irsend.sendRaw(rawDataFan1, 199, 38);  // Send a raw data capture at 38kHz. 
  }
  if (pinValue == 102) {
        //HIGH - ON
       Serial.println(F("2")); // to seral monitor
       irsend.sendRaw(rawDataFan2, 199, 38);  // Send a raw data capture at 38kHz. 
  }
  if (pinValue == 103) {
        //HIGH - ON
       Serial.println(F("3")); // to seral monitor
       irsend.sendRaw(rawDataFan3, 199, 38);  // Send a raw data capture at 38kHz. 
  }
}



// END - implementation procedures

// INITIALIZE PROGRAM

void setup() {
  Blynk.begin(auth, ssid, password, server_ip, 8080); // My Local Server BLYNK
  setupWiFi();
  irsend.begin();
  Serial.begin(115200, SERIAL_8N1, SERIAL_TX_ONLY);
}


// START PROGRAM

void loop() {
Blynk.run();

}
